/*
 * CAUTION: This file is automatically generated by Xilinx.
 * Version:  
 * Today is: Mon Feb 13 11:20:53 2023
 */


/dts-v1/;
/plugin/;
/ {
	fragment@0 {
		target = <&fpga_full>;
		overlay0: __overlay__ {
			#address-cells = <2>;
			#size-cells = <2>;
			firmware-name = "design_1_wrapper.bit.bin";
			resets = <&zynqmp_reset 116>;
		};
	};
	fragment@1 {
		target = <&amba>;
		overlay1: __overlay__ {
			afi0: afi0 {
				compatible = "xlnx,afi-fpga";
				config-afi = < 0 2>, <1 2>, <2 0>, <3 0>, <4 0>, <5 0>, <6 0>, <7 0>, <8 0>, <9 0>, <10 0>, <11 0>, <12 0>, <13 0>, <14 0xa00>, <15 0x000>;
			};
			clocking0: clocking0 {
				#clock-cells = <0>;
				assigned-clock-rates = <99999001>;
				assigned-clocks = <&zynqmp_clk 71>;
				clock-output-names = "fabric_clk";
				clocks = <&zynqmp_clk 71>;
				compatible = "xlnx,fclk";
			};
		};
	};
	fragment@2 {
		target = <&amba>;
		overlay2: __overlay__ {
			#address-cells = <2>;
			#size-cells = <2>;
			// axis_sample_buffer_in_0: axis_sample_buffer_in@b0020000 {
			// 	clock-names = "axilite_clk", "aximm_clk", "stream_in_clk";
			// 	clocks = <&misc_clk_0>, <&misc_clk_0>, <&misc_clk_0>;
			// 	compatible = "xlnx";
			// 	reg = <0x0 0xb0020000 0x0 0x1000 0x0 0xb0200000 0x0 0x80000>;
			// 	xlnx,axilite-addr-width = <0x8>;
			// 	xlnx,axilite-data-width = <0x20>;
			// 	xlnx,aximm-addr-width = <0x13>;
			// 	xlnx,aximm-aruser-width = <0x10>;
			// 	xlnx,aximm-awuser-width = <0x10>;
			// 	xlnx,aximm-buser-width = <0x0>;
			// 	xlnx,aximm-data-width = <0x20>;
			// 	xlnx,aximm-id-width = <0x0>;
			// 	xlnx,aximm-ruser-width = <0x0>;
			// 	xlnx,aximm-wuser-width = <0x0>;
			// };
			//axis_sample_buffer_reg_0: axis_sample_buffer_reg@b02000000 {
			//	compatible = "xlnx";
			//	reg = <0x0 0xb0200000 0x0 0x80000>;
			//};
			dmas_rx_axi_dma_4: dma@a0004000 {
				#dma-cells = <1>;
				clock-names = "s_axi_lite_aclk", "m_axi_sg_aclk", "m_axi_s2mm_aclk";
				clocks = <&zynqmp_clk 71>, <&zynqmp_clk 71>, <&zynqmp_clk 71>;
				compatible = "xlnx";
				interrupt-names = "s2mm_introut";
				interrupt-parent = <&gic>;
				interrupts = <0 92 4>;
				reg = <0x0 0xa0004000 0x0 0x1000>;
				xlnx,addrwidth = <0x20>;
				xlnx,include-sg ;
				xlnx,sg-length-width = <0x1a>;
				dma-channel@a0004000 {
					compatible = "xlnx";
					dma-channels = <0x1>;
					interrupts = <0 92 4>;
					xlnx,datawidth = <0x80>;
					xlnx,device-id = <0x0>;
				};
			};
			dmas_tx_axi_dma_0: dma@a0000000 {
				#dma-cells = <1>;
				clock-names = "s_axi_lite_aclk", "m_axi_sg_aclk", "m_axi_mm2s_aclk";
				clocks = <&zynqmp_clk 71>, <&zynqmp_clk 71>, <&zynqmp_clk 71>;
				compatible = "xlnx";
				interrupt-names = "mm2s_introut";
				interrupt-parent = <&gic>;
				interrupts = <0 89 4>;
				reg = <0x0 0xa0000000 0x0 0x1000>;
				xlnx,addrwidth = <0x20>;
				xlnx,include-sg ;
				xlnx,sg-length-width = <0x1a>;
				dma-channel@a0000000 {
					compatible = "xlnx";
					dma-channels = <0x1>;
					interrupts = <0 89 4>;
					xlnx,datawidth = <0x20>;
					xlnx,device-id = <0x2>;
				};
			};
			dmas_tx_axi_dma_1: dma@a0001000 {
				#dma-cells = <1>;
				clock-names = "s_axi_lite_aclk", "m_axi_sg_aclk", "m_axi_mm2s_aclk";
				clocks = <&zynqmp_clk 71>, <&zynqmp_clk 71>, <&zynqmp_clk 71>;
				compatible = "xlnx";
				interrupt-names = "mm2s_introut";
				interrupt-parent = <&gic>;
				interrupts = <0 90 4>;
				reg = <0x0 0xa0001000 0x0 0x1000>;
				xlnx,addrwidth = <0x20>;
				xlnx,include-sg ;
				xlnx,sg-length-width = <0x1a>;
				dma-channel@a0001000 {
					compatible = "xlnx";
					dma-channels = <0x1>;
					interrupts = <0 90 4>;
					xlnx,datawidth = <0x20>;
					xlnx,device-id = <0x3>;
				};
			};
			dmas_tx_axi_dma_2: dma@a0002000 {
				#dma-cells = <1>;
				clock-names = "s_axi_lite_aclk", "m_axi_sg_aclk", "m_axi_mm2s_aclk";
				clocks = <&zynqmp_clk 71>, <&zynqmp_clk 71>, <&zynqmp_clk 71>;
				compatible = "xlnx";
				interrupt-names = "mm2s_introut";
				interrupt-parent = <&gic>;
				interrupts = <0 91 4>;
				reg = <0x0 0xa0002000 0x0 0x1000>;
				xlnx,addrwidth = <0x20>;
				xlnx,include-sg ;
				xlnx,sg-length-width = <0x1a>;
				dma-channel@a0002000 {
					compatible = "xlnx";
					dma-channels = <0x1>;
					interrupts = <0 91 4>;
					xlnx,datawidth = <0x20>;
					xlnx,device-id = <0x4>;
				};
			};
			dmas_tx_axi_dma_6: dma@a0006000 {
				#dma-cells = <1>;
				clock-names = "s_axi_lite_aclk", "m_axi_sg_aclk", "m_axi_mm2s_aclk";
				clocks = <&zynqmp_clk 71>, <&zynqmp_clk 71>, <&zynqmp_clk 71>;
				compatible = "xlnx";
				interrupt-names = "mm2s_introut";
				interrupt-parent = <&gic>;
				interrupts = <0 93 4>;
				reg = <0x0 0xa0006000 0x0 0x1000>;
				xlnx,addrwidth = <0x20>;
				xlnx,include-sg ;
				xlnx,sg-length-width = <0x1a>;
				dma-channel@a0006000 {
					compatible = "xlnx";
					dma-channels = <0x1>;
					interrupts = <0 93 4>;
					xlnx,datawidth = <0x20>;
					xlnx,device-id = <0x6>;
				};
			};

			rx0_OFDM_demodulator_0: OFDM_demodulator@b0006000 {
				clock-names = "axis_aclk";
				clocks = <&misc_clk_0>;
				compatible = "xlnx,OFDM-demodulator-1.0";
				reg = <0x0 0xb0006000 0x0 0x1000>;
				xlnx,s00-axi-addr-width = <0x4>;
				xlnx,s00-axi-data-width = <0x20>;
			};
			misc_clk_0: misc_clk_0 {
				#clock-cells = <0>;
				clock-frequency = <92160000>;
				compatible = "fixed-clock";
			};
			rx0_fec_hier_fec_controller_0: fec_controller@b0020000 {
				clock-names = "axis_aclk";
				clocks = <&misc_clk_1>;
				compatible = "xlnx,fec-controller-1.0";
				reg = <0x0 0xb0020000 0x0 0x1000>;
				xlnx,s00-axi-addr-width = <0x4>;
				xlnx,s00-axi-data-width = <0x20>;
			};
			misc_clk_1: misc_clk_1 {
				#clock-cells = <0>;
				clock-frequency = <666666666>;
				compatible = "fixed-clock";
			};
			rx0_fec_hier_sd_fec_1: sd-fec@b0080000 {
				clock-names = "core_clk", "s_axi_aclk", "s_axis_ctrl_aclk", "s_axis_din_aclk", "m_axis_status_aclk", "m_axis_dout_aclk";
				clocks = <&misc_clk_2>, <&misc_clk_1>, <&misc_clk_1>, <&misc_clk_1>, <&misc_clk_1>, <&misc_clk_1>;
				compatible = "xlnx";
				reg = <0x0 0xb0080000 0x0 0x40000>;
				xlnx,sdfec-code = "ldpc";
				xlnx,sdfec-din-width = <1>;
				xlnx,sdfec-din-words = <0>;
				xlnx,sdfec-dout-width = <1>;
				xlnx,sdfec-dout-words = <0>;
			};
			rx0_tlast_generator_0: tlast_generator@b0007000 {
				clock-names = "axis_aclk";
				clocks = <&misc_clk_0>;
				compatible = "xlnx,tlast-generator-1.0";
				reg = <0x0 0xb0007000 0x0 0x1000>;
				xlnx,s00-axi-addr-width = <0x4>;
				xlnx,s00-axi-data-width = <0x20>;
			};
			rx0_zf_equalizer_0: zf_equalizer@b0004000 {
				clock-names = "s_axi_aclk";
				clocks = <&misc_clk_0>;
				compatible = "xlnx,zf-equalizer-1.0";
				reg = <0x0 0xb0004000 0x0 0x1000>;
			};
			signal_detect_0: signal_detect@b0002000 {
				clock-names = "clk";
				clocks = <&misc_clk_0>;
				compatible = "xlnx,signal-detect-1.0";
				reg = <0x0 0xb0002000 0x0 0x1000>;
			tx0_fec_hier_fec_controller_0: fec_controller@b0000000 {
				clock-names = "axis_aclk";
				clocks = <&misc_clk_0>;
				compatible = "xlnx,fec-controller-1.0";
				reg = <0x0 0xb0000000 0x0 0x1000>;
				xlnx,s00-axi-addr-width = <0x4>;
				xlnx,s00-axi-data-width = <0x20>;
			};
			tx0_fec_hier_sd_fec_0: sd-fec@b0040000 {
				clock-names = "core_clk", "s_axi_aclk", "s_axis_ctrl_aclk", "s_axis_din_aclk", "m_axis_status_aclk", "m_axis_dout_aclk";
				clocks = <&misc_clk_2>, <&misc_clk_0>, <&misc_clk_0>, <&misc_clk_0>, <&misc_clk_0>, <&misc_clk_0>;
				compatible = "xlnx";
				reg = <0x0 0xb0040000 0x0 0x40000>;
				xlnx,sdfec-code = "ldpc";
				xlnx,sdfec-din-width = <1>;
				xlnx,sdfec-din-words = <0>;
				xlnx,sdfec-dout-width = <1>;
				xlnx,sdfec-dout-words = <0>;
			};
			usp_rf_data_converter_0: usp_rf_data_converter@b0180000 {
				clock-names = "s_axi_aclk", "m0_axis_aclk", "s1_axis_aclk";
				clocks = <&zynqmp_clk 71>, <&misc_clk_0>, <&misc_clk_0>;
				compatible = "xlnx,usp-rf-data-converter-2.5";
				num-insts = <0x1>;
				param-list = [ 00 00 00 00 00 00 18 b0 00 00 00 00 01 00 00 00 00 00 00 00 00 00 00 00 01 00 00 00 01 00 00 00 00 00 00 00 01 00 00 00 00 00 00 00 00 00 00 00 9a 99 99 99 99 99 19 40 00 00 00 00 00 00 b9 40 00 00 00 00 00 00 00 00 0a 00 00 00 02 00 00 00 01 00 00 00 00 00 00 00 9e ef a7 c6 4b 37 1a 40 04 00 00 00 00 00 00 00 00 00 00 00 02 00 00 00 00 00 00 00 00 00 00 00 00 00 00 00 02 00 00 00 00 00 00 00 00 00 00 00 00 00 00 00 02 00 00 00 00 00 00 00 00 00 00 00 00 00 00 00 02 00 00 00 00 00 00 00 00 00 00 00 10 00 00 00 00 00 00 00 00 00 00 00 00 00 00 00 03 00 00 00 00 00 00 00 10 00 00 00 00 00 00 00 00 00 00 00 00 00 00 00 03 00 00 00 00 00 00 00 10 00 00 00 00 00 00 00 00 00 00 00 00 00 00 00 03 00 00 00 00 00 00 00 10 00 00 00 00 00 00 00 00 00 00 00 00 00 00 00 03 00 00 00 01 00 00 00 00 00 00 00 0f d6 ff 39 cc 97 f7 3f 0a d7 a3 70 3d 0a 97 40 0a d7 a3 70 3d 0a 57 40 0a 00 00 00 06 00 00 00 01 00 00 00 00 00 00 00 9e ef a7 c6 4b 37 1a 40 04 00 00 00 00 00 00 00 00 00 00 00 02 00 00 00 00 00 00 00 00 00 00 00 00 00 00 00 02 00 00 00 00 00 00 00 01 00 00 00 00 00 00 00 00 00 00 00 00 00 00 00 01 00 00 00 01 00 00 00 00 00 00 00 00 00 00 00 00 00 00 00 10 00 00 00 00 00 00 00 00 00 00 00 00 00 00 00 03 00 00 00 00 00 00 00 10 00 00 00 00 00 00 00 00 00 00 00 00 00 00 00 03 00 00 00 00 00 00 00 08 00 00 00 04 00 00 00 00 00 00 00 00 00 00 00 01 00 00 00 00 00 00 00 08 00 00 00 04 00 00 00 00 00 00 00 00 00 00 00 01 00 00 00 00 00 00 00 00 00 00 00 9a 99 99 99 99 99 19 40 00 00 00 00 00 00 b9 40 00 00 00 00 00 00 00 00 0a 00 00 00 02 00 00 00 01 00 00 00 00 00 00 00 9e ef a7 c6 4b 37 1a 40 00 00 00 00 00 00 00 00 00 00 00 00 02 00 00 00 00 00 00 00 00 00 00 00 00 00 00 00 02 00 00 00 00 00 00 00 00 00 00 00 00 00 00 00 02 00 00 00 00 00 00 00 00 00 00 00 00 00 00 00 02 00 00 00 00 00 00 00 00 00 00 00 10 00 00 00 00 00 00 00 00 00 00 00 00 00 00 00 03 00 00 00 00 00 00 00 10 00 00 00 00 00 00 00 00 00 00 00 00 00 00 00 03 00 00 00 00 00 00 00 10 00 00 00 00 00 00 00 00 00 00 00 00 00 00 00 03 00 00 00 00 00 00 00 10 00 00 00 00 00 00 00 00 00 00 00 00 00 00 00 03 00 00 00 00 00 00 00 00 00 00 00 9a 99 99 99 99 99 19 40 00 00 00 00 00 00 b9 40 00 00 00 00 00 00 00 00 0a 00 00 00 02 00 00 00 01 00 00 00 00 00 00 00 9e ef a7 c6 4b 37 1a 40 00 00 00 00 00 00 00 00 00 00 00 00 02 00 00 00 00 00 00 00 00 00 00 00 00 00 00 00 02 00 00 00 00 00 00 00 00 00 00 00 00 00 00 00 02 00 00 00 00 00 00 00 00 00 00 00 00 00 00 00 02 00 00 00 00 00 00 00 00 00 00 00 10 00 00 00 00 00 00 00 00 00 00 00 00 00 00 00 03 00 00 00 00 00 00 00 10 00 00 00 00 00 00 00 00 00 00 00 00 00 00 00 03 00 00 00 00 00 00 00 10 00 00 00 00 00 00 00 00 00 00 00 00 00 00 00 03 00 00 00 00 00 00 00 10 00 00 00 00 00 00 00 00 00 00 00 00 00 00 00 03 00 00 00 01 00 00 00 00 00 00 00 0f d6 ff 39 cc 97 f7 3f 0a d7 a3 70 3d 0a 97 40 0a d7 a3 70 3d 0a 57 40 0a 00 00 00 01 00 00 00 01 00 00 00 00 00 00 00 fc a9 f1 d2 4d 62 10 40 02 00 00 00 01 00 00 00 00 00 00 00 01 00 00 00 00 00 00 00 01 00 00 00 00 00 00 00 01 00 00 00 00 00 00 00 01 00 00 00 04 00 00 00 04 00 00 00 00 00 00 00 01 00 00 00 01 00 00 00 04 00 00 00 04 00 00 00 00 00 00 00 01 00 00 00 01 00 00 00 04 00 00 00 04 00 00 00 00 00 00 00 01 00 00 00 01 00 00 00 04 00 00 00 04 00 00 00 00 00 00 00 01 00 00 00 00 00 00 00 00 00 00 00 00 00 00 00 00 00 00 40 00 00 00 00 00 40 9f 40 00 00 00 00 00 00 00 00 0a 00 00 00 01 00 00 00 01 00 00 00 00 00 00 00 fc a9 f1 d2 4d 62 10 40 02 00 00 00 00 00 00 00 02 00 00 00 00 00 00 00 02 00 00 00 00 00 00 00 02 00 00 00 00 00 00 00 02 00 00 00 00 00 00 00 08 00 00 00 00 00 00 00 00 00 00 00 03 00 00 00 00 00 00 00 08 00 00 00 00 00 00 00 00 00 00 00 03 00 00 00 00 00 00 00 08 00 00 00 00 00 00 00 00 00 00 00 03 00 00 00 00 00 00 00 08 00 00 00 00 00 00 00 00 00 00 00 03 00 00 00 00 00 00 00 00 00 00 00 00 00 00 00 00 00 00 40 00 00 00 00 00 40 9f 40 00 00 00 00 00 00 00 00 0a 00 00 00 01 00 00 00 01 00 00 00 00 00 00 00 fc a9 f1 d2 4d 62 10 40 02 00 00 00 00 00 00 00 02 00 00 00 00 00 00 00 02 00 00 00 00 00 00 00 02 00 00 00 00 00 00 00 02 00 00 00 00 00 00 00 08 00 00 00 00 00 00 00 00 00 00 00 03 00 00 00 00 00 00 00 08 00 00 00 00 00 00 00 00 00 00 00 03 00 00 00 00 00 00 00 08 00 00 00 00 00 00 00 00 00 00 00 03 00 00 00 00 00 00 00 08 00 00 00 00 00 00 00 00 00 00 00 03 00 00 00 00 00 00 00 00 00 00 00 00 00 00 00 00 00 00 40 00 00 00 00 00 40 9f 40 00 00 00 00 00 00 00 00 0a 00 00 00 01 00 00 00 01 00 00 00 00 00 00 00 fc a9 f1 d2 4d 62 10 40 02 00 00 00 00 00 00 00 02 00 00 00 00 00 00 00 02 00 00 00 00 00 00 00 02 00 00 00 00 00 00 00 02 00 00 00 00 00 00 00 08 00 00 00 00 00 00 00 00 00 00 00 03 00 00 00 00 00 00 00 08 00 00 00 00 00 00 00 00 00 00 00 03 00 00 00 00 00 00 00 08 00 00 00 00 00 00 00 00 00 00 00 03 00 00 00 00 00 00 00 08 00 00 00 00 00 00 00 00 00 00 00 03 00 00 00];
				reg = <0x0 0xb0180000 0x0 0x40000>;
			};
			dma_piradio0: dma_piradio0{
				compatible ="xlnx,piradio0";
				dmas = <&dmas_tx_axi_dma_0 0
								&dmas_tx_axi_dma_1 0
								&dmas_tx_axi_dma_2 0
								&dmas_rx_axi_dma_4 1
								&dmas_tx_axi_dma_6 0>;
				dma-names = "piradio0_tx", "piradio0_config", "piradio0_config_corr", "piradio0_rx", "piradio0_framer_ctrl", "piradio0_fec_tx_ctrl";
				mydms = <&dmas_tx_axi_dma_0 &dmas_tx_axi_dma_1 &dmas_tx_axi_dma_2 &dmas_rx_axi_dma_4 &dmas_tx_axi_dma_6>;
				iface-main;
				mod_reg = <&rx0_OFDM_demodulator_0>;
				fec_tx_reg =  <&tx0_fec_hier_sd_fec_0 &tx0_fec_hier_fec_controller_0>;
				fec_rx_reg =  <&rx0_fec_hier_sd_fec_1 &rx0_fec_hier_fec_controller_0>;
				tlast_reg = <&rx0_tlast_generator_0>;
				log_reg = <&axis_sample_buffer_reg_0>;
			};
		};
	};
};
